    .section .text.start,"ax",@progbits
    .global _start
    .type _start,@function
_start:
    .option push
    .option norelax
    la gp, __global_pointer$
    .option pop
    la sp, __stack_top
    csrw mie, zero
    csrw mstatus, zero
    la t0, trap_entry
    csrw mtvec, t0
    la t0, __bss_start
    la t1, __bss_end
1:  bgeu t0, t1, 2f
    sw zero, 0(t0)
    addi t0, t0, 4
    j 1b
2:  call main
3:  j 3b

    .balign 4
trap_entry:
    /* Preserve evidence for JTAG. Unexpected APB faults/illegal instructions
     * are fatal; never keep configuring a camera with corrupted execution. */
    csrr a0, mcause
    csrr a1, mepc
    csrr a2, mtval
    tail firmware_trap
    .size _start, .-_start
